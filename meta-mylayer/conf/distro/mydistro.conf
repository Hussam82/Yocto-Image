## meta-mylayer/conf/distro/mydistro.conf
```bitbake
#Distro Layer Configuration
require conf/distro/poky.conf
DISTRO = "mydistro"
DISTRO_NAME = "MyDistro-Hussam"
DISTRO_VERSION = "1.0"
DISTRO_CODENAME = "codename"
SDK_VENDOR = "-mydistro"
SDK_VERSION = "${DISTRO_VERSION}"
MAINTAINER = "hussam@mydistro.com"
TARGET_VENDOR = "-mydistro"

#Use systemd as init manager
DISTRO_FEATURES += "systemd wifi opengl"
VIRTUAL-RUNTIME_init_manager = "systemd"
VIRTUAL-RUNTIME_initscripts = "systemd-compat-units"
DISTRO_FEATURES_BACKFILL_CONSIDERED += "sysvinit"

EXTRA_IMAGE_FEATURES:append = " package-management"

#Set GPU Memory to 128 MB
GPU_MEM = "128"

#Enable VC4GRAPHICS
VC4GRAPHICS = "1"

HDMI_GROUP = "1"

# 1080p 60 Hz Screen
HDMI_MODE = "16"

VIDEO_CAMERA = "1"
RASPBERRYPI_CAMERA_V2 = "1"
ENABLE_DWC2_HOST = "1"
```
